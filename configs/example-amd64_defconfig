## configs/example-amd64_defconfig
```kconfig
CONFIG_USE_OPTION_TABLE=y
CONFIG_BOARD_EMULATION_QEMU_X86_Q35=y
CONFIG_COREBOOT_ROMSIZE_KB_8192=y
CONFIG_PAYLOAD_NONE=y
```

## configs/platina-mk1_defconfig
```kconfig
CONFIG_USE_OPTION_TABLE=y
CONFIG_VENDOR_INTEL=y
CONFIG_FSP_FILE="3rdparty/intel-blobs/fsp/broadwell_de/platina-mk1.bin"
CONFIG_CBFS_SIZE=0x00800000
CONFIG_ENABLE_FSP_FAST_BOOT=y
CONFIG_BOARD_INTEL_CAMELBACKMOUNTAIN_PLATINA_FSP=y
CONFIG_FSP_LOC=0xffedf680
CONFIG_COREBOOT_ROMSIZE_KB_16384=y
CONFIG_CPU_MICROCODE_HEADER_FILES="3rdparty/intel-blobs/microcode/cpu/broadwell_de/M1050663_07000009.h 3rdparty/intel-blobs/microcode/cpu/broadwell_de/M1050662_0000000F.h 3rdparty/intel-blobs/microcode/cpu/broadwell_de/MFF50661_F1000008.h"
CONFIG_HAVE_FSP_BIN=y
# CONFIG_ON_DEVICE_ROM_LOAD is not set
CONFIG_DEFAULT_CONSOLE_LOGLEVEL_8=y
CONFIG_CONSOLE_POST=y
CONFIG_PAYLOAD_NONE=y
```

## src/mainboard/intel/camelbackmountain_fsp/Kconfig.name
```kconfig
config BOARD_INTEL_CAMELBACKMOUNTAIN_FSP
	bool "Camelback Mountain FSP-based CRB"

config BOARD_INTEL_CAMELBACKMOUNTAIN_PLATINA_FSP
	bool "Camelback Mountain Platina FSP-based DC"
```

## src/mainboard/platina/Kconfig
```kconfig
if VENDOR_PLATINA

choice
	prompt "Mainboard model"

source "src/mainboard/platina/*/Kconfig.name"

endchoice

source "src/mainboard/platina/*/Kconfig"

config MAINBOARD_VENDOR
	string
	default "Platina"

endif # VENDOR_PLATINA
```

## src/mainboard/platina/mk1/Kconfig
```kconfig
if BOARD_PLATINA_MK1

config BOARD_SPECIFIC_OPTIONS
	def_bool y
	select SOC_INTEL_FSP_BROADWELL_DE
	select BOARD_ROMSIZE_KB_2048
	select HAVE_ACPI_TABLES
	select HAVE_OPTION_TABLE
	select INTEGRATED_UART if FSP_PACKAGE_DEFAULT
	select HAVE_FSP_BIN if FSP_PACKAGE_DEFAULT
	select SERIRQ_CONTINUOUS_MODE
	select MAINBOARD_USES_IFD_GBE_REGION

config MAINBOARD_DIR
	string
	default "platina/mk1"

config MAINBOARD_PART_NUMBER
	string
	default "DC-MK1-1"

config IRQ_SLOT_COUNT
	int
	default 18

config CBFS_SIZE
	hex
	default 0x00200000

config VIRTUAL_ROM_SIZE
	hex
	default 0x1000000

config DRIVERS_UART_8250IO
	def_bool n

config FSP_PACKAGE_DEFAULT
	bool "Configure defaults for the Intel FSP package"
	default n

endif # BOARD_PLATINA_MK1
```
